## experiments/cloudflare-tunnel/sdkconfig.defaults
```kconfig
CONFIG_IDF_TARGET="esp32s3"
CONFIG_ESPTOOLPY_FLASHSIZE_8MB=y
CONFIG_ESP_CONSOLE_USB_SERIAL_JTAG=y
CONFIG_ESP_CONSOLE_SECONDARY_NONE=y
CONFIG_PARTITION_TABLE_SINGLE_APP_LARGE=y
CONFIG_MBEDTLS_SSL_PROTO_TLS1_3=y
CONFIG_MBEDTLS_ASYMMETRIC_CONTENT_LEN=y
CONFIG_MBEDTLS_SSL_IN_CONTENT_LEN=16384
CONFIG_MBEDTLS_SSL_OUT_CONTENT_LEN=4096
CONFIG_ESP_MAIN_TASK_STACK_SIZE=6144
CONFIG_FREERTOS_HZ=100
CONFIG_ESP_TASK_WDT_INIT=n
```

## flue-monitor/main/Kconfig.projbuild
```kconfig
menu "Temporary feature isolation diagnostics"

config FLUE_DIAG_RECORDER
    bool "Record recent events in internal RAM and a small RTC tail"
    depends on ESP_COREDUMP_ENABLE
    default n

config FLUE_DIAG_CRASH_TEST
    bool "Allow a controlled crash through the physical UART console"
    depends on FLUE_DIAG_RECORDER
    default n

config FLUE_DIAG_DISABLE_SHEETS
    bool "Do not start Google Sheets uploads (preserve saved configuration)"
    default n

config FLUE_DIAG_DISABLE_HTTP
    bool "Do not start HTTP, WebSocket or OTA (USB recovery required)"
    default n

config FLUE_DIAG_JSON_INTERNAL
    bool "Keep JSON allocations in internal RAM"
    default n

config FLUE_DIAG_SKIP_PSRAM_STATS
    bool "Do not query live PSRAM heap statistics"
    default n

config FLUE_DIAG_HISTORY_RING_INTERNAL
    bool "Keep the temperature history ring in internal RAM"
    default n

config FLUE_DIAG_HISTORY_API_INTERNAL
    bool "Keep the history API copy in internal RAM"
    default n

config FLUE_DIAG_ASSETS_INTERNAL
    bool "Keep asset decompression buffers in internal RAM"
    default n

endmenu
```
